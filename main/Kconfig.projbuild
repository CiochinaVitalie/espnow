## main/Kconfig.projbuild
```kconfig
menu "Sensor node configuration"

    config ESPNOW_ROLE_SENDER
        bool "This device is the sender (otherwise receiver)"
        default y
        help
            Sender reads the sensors and transmits; receiver only prints what it gets.

    config ESPNOW_RECEIVER_MAC
        string "Receiver MAC address (sender only)"
        default "08:3A:F2:AC:52:FC"
        depends on ESPNOW_ROLE_SENDER
        help
            MAC of the receiver board, format AA:BB:CC:DD:EE:FF.
            The receiver prints its own MAC at start-up.

    config SENSORS_I2C_SDA
        int "I2C SDA GPIO"
        default 21

    config SENSORS_I2C_SCL
        int "I2C SCL GPIO"
        default 22

    config SENSORS_POLL_PERIOD_MS
        int "SHT40 polling period, ms"
        range 100 600000
        default 5000

endmenu
```
